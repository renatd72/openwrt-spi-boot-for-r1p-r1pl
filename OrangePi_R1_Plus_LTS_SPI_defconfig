## OrangePi_R1_Plus_LTS_SPI_defconfig
```kconfig
CONFIG_TARGET_rockchip=y
CONFIG_TARGET_rockchip_armv8spi=y
CONFIG_TARGET_rockchip_armv8spi_DEVICE_xunlong_orangepi-r1-plus-lts=y
# CONFIG_PACKAGE_dnsmasq is not set
CONFIG_PACKAGE_dnsmasq-full=y
# CONFIG_LUCI_LANG_zh_Hans is not set
CONFIG_PACKAGE_luci-app-mwan3=y
#CONFIG_PACKAGE_kmod-ipt-nat6  is not set
#CONFIG_PACKAGE_kmod-nf-nat6 is not set
CONFIG_PACKAGE_kmod-usb-serial-option=y
CONFIG_PACKAGE_rt2800-usb-firmware=y
CONFIG_PACKAGE_kmod-rt2800-usb=y
CONFIG_PACKAGE_wpad-mini=y
CONFIG_PACKAGE_mc=y
#CONFIG_PACKAGE_net-tools-route
CONFIG_PACKAGE_kmod-fuse=y
CONFIG_PACKAGE_sshfs=y
CONFIG_PACKAGE_openssh-client=y
#CONFIG_PACKAGE_zerotier
CONFIG_PACKAGE_openvpn-openssl=y
CONFIG_PACKAGE_luci-app-openvpn=y
#CONFIG_PACKAGE_wireguard-tools=y
#CONFIG_PACKAGE_luci-proto-wireguard=y
#CONFIG_PACKAGE_luci-app-wireguard=y
#CONFIG_PACKAGE_kmod-wireguard=y
#CONFIG_PACKAGE_curl=
#CONFIG_PACKAGE_https-dns-proxy=n
CONFIG_PACKAGE_kmod-mt7921-common=y
CONFIG_PACKAGE_kmod-mt7921-firmware=y
CONFIG_PACKAGE_kmod-mt7921e=y
CONFIG_PACKAGE_kmod-mt7921s=y
CONFIG_PACKAGE_kmod-mt7921u=y
```
